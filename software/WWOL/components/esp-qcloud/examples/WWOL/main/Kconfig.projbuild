## software/WWOL/components/esp-qcloud/examples/WWOL/main/Kconfig.projbuild
```kconfig
menu "WWOL Configuration"
    menu "Light provisioning network selection"
        config LIGHT_PROVISIONING_SMARTCONFIG
            bool "Enable SmartConfig's smart network configuration method"
            default n
            help
                Enable SmartConfig's smart network configuration method
        
        config LIGHT_PROVISIONING_SOFTAPCONFIG
            bool "Enable SoftAP's network configuration method"
            default y
            help
                "Enable SoftAP's network configuration method"

        config LIGHT_PROVISIONING_BLECONFIG
            depends on IDF_TARGET_ESP32 || IDF_TARGET_ESP32C3
            bool "Enable BLE's network configuration method"
            default y
            help
                "Enable BLE's network configuration method"

        config LIGHT_PROVISIONING_SOFTAPCONFIG_SSID
            depends on LIGHT_PROVISIONING_SOFTAPCONFIG
            string "SoftAP ssid"
            default "tcloud_XXX"
            help
                SSID (network name) for the phone to connect to.

        config LIGHT_PROVISIONING_SOFTAPCONFIG_PASSWORD
            depends on LIGHT_PROVISIONING_SOFTAPCONFIG
            string "SoftAP password"
            default ""
            help
                WiFi password (WPA or WPA2) for the example to use.
                Can be left blank if the network has no security set.

        config LIGHT_PROVISIONING_BLECONFIG_NAME
            depends on LIGHT_PROVISIONING_BLECONFIG
            string "BLE name"
            default "Qcloud"
            help
                BLE for the phone to connect to.
    endmenu

    config LIGHT_REBOOT_UNBROKEN_COUNT_RESET
        int "More than this number of continuous uninterrupted restarts triggers a reset of the device"
        range 3 15
        default 5
        help
            Devices without buttons trigger a device reset through continuous restart.

    config LIGHT_DEBUG
        bool "The device will be in debug mode"
        default n
        help
            Debug mode device performance is only used during development.

endmenu
```
